## firmware/ring/main/Kconfig.projbuild
```kconfig
# SPDX-License-Identifier: MIT
# PowerFinger Ring — Project-level Kconfig

menu "PowerFinger Configuration"

    choice POWERFINGER_SENSOR_DRIVER
        prompt "Sensor driver"
        default SENSOR_NONE
        help
            Select the motion sensor driver. Use NONE for Phase 0
            (fake data, BLE HID validation only).

        config SENSOR_NONE
            bool "None (fake data for Phase 0)"

        config SENSOR_PAW3204
            bool "PAW3204 optical (Standard tier)"

        config SENSOR_PMW3360
            bool "PMW3360 optical-on-ball (Pro tier)"

        config SENSOR_BALL_HALL
            bool "Ball+Hall 4x DRV5053 (ADC, surface-agnostic)"
    endchoice

    choice POWERFINGER_CLICK_INPUT
        prompt "Click input"
        default CLICK_NONE
        help
            Select the click input mechanism. Use NONE for Phase 0.

        config CLICK_NONE
            bool "None (no click for Phase 0)"

        config CLICK_SNAP_DOME
            bool "Snap dome (GPIO, Standard tier)"

        config CLICK_PIEZO_LRA
            bool "Piezo + LRA haptic (ADC + PWM, Pro tier)"
    endchoice

    config POWERFINGER_SENSOR_SCLK_PIN
        int "Sensor serial clock GPIO pin"
        default 4
        depends on SENSOR_PAW3204 || SENSOR_PMW3360

    config POWERFINGER_SENSOR_SDIO_PIN
        int "Sensor SDIO / MOSI GPIO pin"
        default 5
        depends on SENSOR_PAW3204 || SENSOR_PMW3360

    config POWERFINGER_SENSOR_NCS_PIN
        int "Sensor chip select GPIO pin"
        default 6
        depends on SENSOR_PAW3204 || SENSOR_PMW3360

    config POWERFINGER_SENSOR_MISO_PIN
        int "Sensor MISO GPIO pin (PMW3360 SPI only)"
        default 7
        depends on SENSOR_PMW3360

    config POWERFINGER_PMW3360_CPI_DEFAULT
        int "PMW3360 default CPI (100-12000, steps of 100)"
        default 1600
        depends on SENSOR_PMW3360
        help
            Default CPI for the PMW3360 sensor. 1600 is a good starting
            point for Pro tier. Runtime-adjustable via BLE DPI multiplier.

    config POWERFINGER_HALL_ADC_CH_X_POS
        int "Hall X+ ADC channel"
        default 1
        depends on SENSOR_BALL_HALL
        help
            ADC1 channel for the DRV5053 sensor on the positive X roller.

    config POWERFINGER_HALL_ADC_CH_X_NEG
        int "Hall X- ADC channel"
        default 2
        depends on SENSOR_BALL_HALL
        help
            ADC1 channel for the DRV5053 sensor on the negative X roller.

    config POWERFINGER_HALL_ADC_CH_Y_POS
        int "Hall Y+ ADC channel"
        default 3
        depends on SENSOR_BALL_HALL
        help
            ADC1 channel for the DRV5053 sensor on the positive Y roller.

    config POWERFINGER_HALL_ADC_CH_Y_NEG
        int "Hall Y- ADC channel"
        default 4
        depends on SENSOR_BALL_HALL
        help
            ADC1 channel for the DRV5053 sensor on the negative Y roller.

    config POWERFINGER_HALL_SENSITIVITY
        int "Hall sensor sensitivity (mv-to-counts scale factor x10)"
        default 10
        depends on SENSOR_BALL_HALL
        help
            Scale factor for converting millivolt differentials to HID
            delta counts, in 0.1x units. 10 = 1.0x (1mV differential =
            1 count). Needs hardware tuning — this is a placeholder.

    config POWERFINGER_DOME_PIN
        int "Snap dome GPIO pin"
        default 8
        depends on CLICK_SNAP_DOME

    config POWERFINGER_VBAT_ADC_CHANNEL
        int "VBAT ADC channel number"
        default 0

    config POWERFINGER_NTC_ADC_CHANNEL
        int "NTC ADC channel number (-1 if not populated)"
        default -1
        help
            ADC channel used for the cell-temperature NTC divider.
            Set to -1 for pre-hardware dev boards or variants where the
            charging-safety thermistor is not yet populated.

    config POWERFINGER_CHARGE_ENABLE_PIN
        int "Charge-enable MOSFET GPIO pin (-1 if not populated)"
        default -1
        help
            GPIO driving the P-channel MOSFET gate that enables VBUS into
            the charge controller. Set to -1 when the board has no firmware-
            controlled charge gate yet.

    config POWERFINGER_VBUS_DETECT_PIN
        int "USB VBUS detect GPIO pin (-1 if not populated)"
        default -1
        help
            GPIO that reads USB VBUS presence through a resistor divider.
            Set to -1 for dev-board bring-up or boards without the finished
            charge/safety path.

    config POWERFINGER_HALL_POWER_PIN
        int "Hall sensor power gate GPIO pin"
        default 9
        help
            GPIO controlling MOSFET for Hall sensor VCC rail
            (ball variants only). Set to -1 if not used.

    config POWERFINGER_WAKE_GPIO_MASK
        int "Deep sleep wake GPIO bitmask"
        default 256 if CLICK_SNAP_DOME
        default 0
        help
            Bitmask of GPIOs enabled as deep sleep wake sources.
            Bits correspond to GPIO numbers (for example GPIO8 = 0x100).
            PowerPen will override this with a three-GPIO mask.

    config POWERFINGER_DEVICE_NAME
        string "BLE device name"
        default "PowerFinger Ring"
        help
            BLE GAP device name advertised to hosts and displayed
            during pairing. Override per form factor.

    config POWERFINGER_SLEEP_TIMEOUT_MS
        int "Idle-to-sleep timeout (ms)"
        default 45000
        help
            Duration of no activity before entering deep sleep from
            CONNECTED_IDLE. Desktop puck uses 60000 to survive typing
            pauses without sleeping.

endmenu
```
