## firmware/hub/sdkconfig.defaults
```kconfig
# SPDX-License-Identifier: MIT
# PowerFinger USB Hub Dongle — Default Kconfig

# Target: ESP32-S3
CONFIG_IDF_TARGET="esp32s3"

# Flash: 8MB (ESP32-S3-MINI-1-N8)
CONFIG_ESPTOOLPY_FLASHSIZE_8MB=y

# Partition table: custom (OTA A/B + NVS)
CONFIG_PARTITION_TABLE_CUSTOM=y
CONFIG_PARTITION_TABLE_CUSTOM_FILENAME="partitions.csv"

# Bluetooth: NimBLE, central role
CONFIG_BT_ENABLED=y
CONFIG_BT_NIMBLE_ENABLED=y
CONFIG_BT_NIMBLE_ROLE_CENTRAL=y
CONFIG_BT_NIMBLE_ROLE_PERIPHERAL=n
CONFIG_BT_NIMBLE_ROLE_OBSERVER=y
CONFIG_BT_NIMBLE_ROLE_BROADCASTER=n

# NimBLE: max connections (hub connects to up to 4 rings)
CONFIG_BT_NIMBLE_MAX_CONNECTIONS=4

# NimBLE: enable bonding, security manager
CONFIG_BT_NIMBLE_SM_LEGACY=y
CONFIG_BT_NIMBLE_SM_SC=y

# USB: enable TinyUSB HID
CONFIG_TINYUSB_HID_ENABLED=y

# Watchdog
CONFIG_ESP_TASK_WDT_EN=y
CONFIG_ESP_TASK_WDT_TIMEOUT_S=10

# OTA: enable rollback
CONFIG_BOOTLOADER_APP_ROLLBACK_ENABLE=y

# Log level
CONFIG_LOG_DEFAULT_LEVEL_INFO=y
```

## firmware/pen/main/Kconfig.projbuild
```kconfig
# SPDX-License-Identifier: MIT
# PowerPen — Project-level Kconfig
#
# Reuses the shared ring components. PP2 maps the existing single-click driver
# to the barrel switch; PP3 will add the true dual-click path.

menu "PowerFinger Configuration"

    choice POWERFINGER_FORM_FACTOR
        prompt "Form factor"
        default POWERFINGER_FORM_FACTOR_PEN
        help
            Select the physical form factor for user-visible identity.

        config POWERFINGER_FORM_FACTOR_RING
            bool "Ring"

        config POWERFINGER_FORM_FACTOR_PUCK
            bool "Puck"

        config POWERFINGER_FORM_FACTOR_PEN
            bool "Pen"
    endchoice

    choice POWERFINGER_SENSOR_DRIVER
        prompt "Sensor driver"
        default SENSOR_BALL_HALL
        help
            Select the motion sensor driver for the current pen build.

        config SENSOR_NONE
            bool "None (fake data for Phase 0)"

        config SENSOR_PAW3204
            bool "PAW3204 optical (Standard tier)"

        config SENSOR_PMW3360
            bool "PMW3360 optical-on-ball (Pro tier)"

        config SENSOR_BALL_HALL
            bool "Ball+Hall 4x DRV5053 (ADC, surface-agnostic)"
    endchoice

    choice POWERFINGER_CLICK_INPUT
        prompt "Click input"
        default CLICK_SNAP_DOME
        help
            PP2 maps the shared single-click GPIO path to the barrel switch.

        config CLICK_NONE
            bool "None (no click)"

        config CLICK_SNAP_DOME
            bool "Single GPIO click (PP2 barrel compatibility)"

        config CLICK_PIEZO_LRA
            bool "Piezo + LRA haptic (Pro tier)"
    endchoice

    config POWERFINGER_HALL_ADC_CH_X_POS
        int "Hall X+ ADC channel"
        default 0
        depends on SENSOR_BALL_HALL

    config POWERFINGER_HALL_ADC_CH_X_NEG
        int "Hall X- ADC channel"
        default 1
        depends on SENSOR_BALL_HALL

    config POWERFINGER_HALL_ADC_CH_Y_POS
        int "Hall Y+ ADC channel"
        default 2
        depends on SENSOR_BALL_HALL

    config POWERFINGER_HALL_ADC_CH_Y_NEG
        int "Hall Y- ADC channel"
        default 3
        depends on SENSOR_BALL_HALL

    config POWERFINGER_HALL_SENSITIVITY
        int "Hall sensor sensitivity (mv-to-counts scale factor x10)"
        default 10
        depends on SENSOR_BALL_HALL

    config POWERFINGER_BARREL_PIN
        int "Barrel switch GPIO pin"
        default 4

    config POWERFINGER_TIP_DOME_PIN
        int "Tip dome GPIO pin"
        default 5

    config POWERFINGER_WAKE_SENSOR_PIN
        int "DRV5032 wake sensor GPIO pin"
        default 8

    config POWERFINGER_DOME_PIN
        int "Primary click GPIO pin"
        default 4
        depends on CLICK_SNAP_DOME
        help
            PP2 compatibility mapping for the existing single-click driver.
            This should stay aligned with the barrel switch until PP3 lands.

    config POWERFINGER_VBAT_ADC_CHANNEL
        int "VBAT ADC channel number"
        default 7

    config POWERFINGER_HALL_POWER_PIN
        int "Hall sensor power gate GPIO pin"
        default 6
        help
            GPIO controlling the MOSFET for the Hall sensor VCC rail.

    config POWERFINGER_HALL_POWER_ACTIVE_LOW
        bool "Hall sensor power gate is active-low"
        default y
        help
            The PowerPen uses a P-channel MOSFET on GPIO6, so driving the
            gate low enables the Hall sensor rail.

    config POWERFINGER_WAKE_GPIO_MASK
        int "Deep sleep wake GPIO bitmask"
        default 0x130
        help
            Bitmask of GPIOs enabled as deep sleep wake sources.
            PowerPen default is GPIO4 | GPIO5 | GPIO8.

    config POWERFINGER_DEVICE_NAME
        string "BLE device name"
        default "PowerPen"
        help
            BLE GAP device name advertised to hosts and displayed
            during pairing.

    config POWERFINGER_SLEEP_TIMEOUT_MS
        int "Idle-to-sleep timeout (ms)"
        default 45000
        help
            Duration of no activity before entering deep sleep from
            CONNECTED_IDLE.

endmenu
```

## firmware/pen/sdkconfig.defaults
```kconfig
# SPDX-License-Identifier: MIT
# PowerPen — Default Kconfig

# Target: ESP32-C3
CONFIG_IDF_TARGET="esp32c3"

# Flash: 4MB
CONFIG_ESPTOOLPY_FLASHSIZE_4MB=y

# Partition table: custom (OTA A/B + NVS)
CONFIG_PARTITION_TABLE_CUSTOM=y
CONFIG_PARTITION_TABLE_CUSTOM_FILENAME="partitions.csv"

# Bluetooth: NimBLE only (no classic BT on C3)
CONFIG_BT_ENABLED=y
CONFIG_BT_NIMBLE_ENABLED=y
CONFIG_BT_NIMBLE_ROLE_PERIPHERAL=y
CONFIG_BT_NIMBLE_ROLE_CENTRAL=n
CONFIG_BT_NIMBLE_ROLE_OBSERVER=n
CONFIG_BT_NIMBLE_ROLE_BROADCASTER=y

# NimBLE: enable bonding, security manager
CONFIG_BT_NIMBLE_SM_LEGACY=y
CONFIG_BT_NIMBLE_SM_SC=y

# NimBLE: max connections (pen is peripheral, 1 connection)
CONFIG_BT_NIMBLE_MAX_CONNECTIONS=1

# Power management: enable light sleep
CONFIG_PM_ENABLE=y
CONFIG_PM_DFS_INIT_AUTO=y

# Watchdog
CONFIG_ESP_TASK_WDT_EN=y
CONFIG_ESP_TASK_WDT_TIMEOUT_S=10

# OTA: enable
CONFIG_BOOTLOADER_APP_ROLLBACK_ENABLE=y

# Log level: info for development
CONFIG_LOG_DEFAULT_LEVEL_INFO=y

# --- PowerPen-specific overrides ---

# Form factor identity
CONFIG_POWERFINGER_FORM_FACTOR_PEN=y

# Device name: "PowerPen"
CONFIG_POWERFINGER_DEVICE_NAME="PowerPen"

# Sensor: ball+Hall prototype
CONFIG_SENSOR_BALL_HALL=y
CONFIG_POWERFINGER_HALL_ADC_CH_X_POS=0
CONFIG_POWERFINGER_HALL_ADC_CH_X_NEG=1
CONFIG_POWERFINGER_HALL_ADC_CH_Y_POS=2
CONFIG_POWERFINGER_HALL_ADC_CH_Y_NEG=3
CONFIG_POWERFINGER_HALL_SENSITIVITY=10

# Click: PP3 uses the pen-specific dual-GPIO driver selected behind the shared
# CLICK_SNAP_DOME mode. The compatibility alias stays mapped to the barrel pin.
CONFIG_CLICK_SNAP_DOME=y
CONFIG_POWERFINGER_BARREL_PIN=4
CONFIG_POWERFINGER_TIP_DOME_PIN=5
CONFIG_POWERFINGER_DOME_PIN=4

# Wake sources: barrel, tip dome, DRV5032 (GPIO4 | GPIO5 | GPIO8)
CONFIG_POWERFINGER_WAKE_SENSOR_PIN=8
CONFIG_POWERFINGER_WAKE_GPIO_MASK=304
CONFIG_POWERFINGER_WAKE_VALIDATION_MS=200
CONFIG_POWERFINGER_SPURIOUS_WAKE_LIMIT=3
CONFIG_POWERFINGER_SPURIOUS_WAKE_WINDOW_MS=30000

# Hall power gate and battery monitor
CONFIG_POWERFINGER_HALL_POWER_PIN=6
CONFIG_POWERFINGER_HALL_POWER_ACTIVE_LOW=y
CONFIG_POWERFINGER_VBAT_ADC_CHANNEL=7

# Current pen bring-up default: keep the timeout explicit in the pen target so
# PP6 tuning can change it without touching shared defaults.
CONFIG_POWERFINGER_SLEEP_TIMEOUT_MS=45000
```

## firmware/puck/main/Kconfig.projbuild
```kconfig
# SPDX-License-Identifier: MIT
# PowerPuck — Project-level Kconfig
#
# Identical choices to the ring. Puck-specific defaults are set in
# sdkconfig.defaults (DEVICE_NAME="PowerPuck", SLEEP_TIMEOUT_MS=60000).

menu "PowerFinger Configuration"

    choice POWERFINGER_SENSOR_DRIVER
        prompt "Sensor driver"
        default SENSOR_NONE
        help
            Select the motion sensor driver. Use NONE for Phase 0
            (fake data, BLE HID validation only).

        config SENSOR_NONE
            bool "None (fake data for Phase 0)"

        config SENSOR_PAW3204
            bool "PAW3204 optical (Standard tier)"

        config SENSOR_PMW3360
            bool "PMW3360 optical-on-ball (Pro tier)"

        config SENSOR_BALL_HALL
            bool "Ball+Hall 4x DRV5053 (ADC, surface-agnostic)"
    endchoice

    choice POWERFINGER_CLICK_INPUT
        prompt "Click input"
        default CLICK_NONE
        help
            Select the click input mechanism. Use NONE for Phase 0.

        config CLICK_NONE
            bool "None (no click for Phase 0)"

        config CLICK_SNAP_DOME
            bool "Snap dome (GPIO, Standard tier)"

        config CLICK_PIEZO_LRA
            bool "Piezo + LRA haptic (ADC + PWM, Pro tier)"
    endchoice

    config POWERFINGER_SENSOR_SCLK_PIN
        int "Sensor serial clock GPIO pin"
        default 4
        depends on SENSOR_PAW3204 || SENSOR_PMW3360

    config POWERFINGER_SENSOR_SDIO_PIN
        int "Sensor SDIO / MOSI GPIO pin"
        default 5
        depends on SENSOR_PAW3204 || SENSOR_PMW3360

    config POWERFINGER_SENSOR_NCS_PIN
        int "Sensor chip select GPIO pin"
        default 6
        depends on SENSOR_PAW3204 || SENSOR_PMW3360

    config POWERFINGER_SENSOR_MISO_PIN
        int "Sensor MISO GPIO pin (PMW3360 SPI only)"
        default 7
        depends on SENSOR_PMW3360

    config POWERFINGER_PMW3360_CPI_DEFAULT
        int "PMW3360 default CPI (100-12000, steps of 100)"
        default 1600
        depends on SENSOR_PMW3360

    config POWERFINGER_HALL_ADC_CH_X_POS
        int "Hall X+ ADC channel"
        default 1
        depends on SENSOR_BALL_HALL

    config POWERFINGER_HALL_ADC_CH_X_NEG
        int "Hall X- ADC channel"
        default 2
        depends on SENSOR_BALL_HALL

    config POWERFINGER_HALL_ADC_CH_Y_POS
        int "Hall Y+ ADC channel"
        default 3
        depends on SENSOR_BALL_HALL

    config POWERFINGER_HALL_ADC_CH_Y_NEG
        int "Hall Y- ADC channel"
        default 4
        depends on SENSOR_BALL_HALL

    config POWERFINGER_HALL_SENSITIVITY
        int "Hall sensor sensitivity (mv-to-counts scale factor x10)"
        default 10
        depends on SENSOR_BALL_HALL

    config POWERFINGER_DOME_PIN
        int "Snap dome GPIO pin"
        default 8
        depends on CLICK_SNAP_DOME

    config POWERFINGER_VBAT_ADC_CHANNEL
        int "VBAT ADC channel number"
        default 0

    config POWERFINGER_HALL_POWER_PIN
        int "Hall sensor power gate GPIO pin"
        default 9
        help
            GPIO controlling MOSFET for Hall sensor VCC rail
            (ball variants only). Set to -1 if not used.

    config POWERFINGER_DEVICE_NAME
        string "BLE device name"
        default "PowerPuck"
        help
            BLE GAP device name advertised to hosts and displayed
            during pairing.

    config POWERFINGER_SLEEP_TIMEOUT_MS
        int "Idle-to-sleep timeout (ms)"
        default 60000
        help
            Duration of no activity before entering deep sleep from
            CONNECTED_IDLE. 60s default survives typical typing pauses
            without sleeping.

endmenu
```

## firmware/puck/sdkconfig.defaults
```kconfig
# SPDX-License-Identifier: MIT
# PowerPuck — Default Kconfig

# Target: ESP32-C3
CONFIG_IDF_TARGET="esp32c3"

# Flash: 4MB
CONFIG_ESPTOOLPY_FLASHSIZE_4MB=y

# Partition table: custom (OTA A/B + NVS)
CONFIG_PARTITION_TABLE_CUSTOM=y
CONFIG_PARTITION_TABLE_CUSTOM_FILENAME="partitions.csv"

# Bluetooth: NimBLE only (no classic BT on C3)
CONFIG_BT_ENABLED=y
CONFIG_BT_NIMBLE_ENABLED=y
CONFIG_BT_NIMBLE_ROLE_PERIPHERAL=y
CONFIG_BT_NIMBLE_ROLE_CENTRAL=n
CONFIG_BT_NIMBLE_ROLE_OBSERVER=n
CONFIG_BT_NIMBLE_ROLE_BROADCASTER=y

# NimBLE: enable bonding, security manager
CONFIG_BT_NIMBLE_SM_LEGACY=y
CONFIG_BT_NIMBLE_SM_SC=y

# NimBLE: max connections (puck is peripheral, 1 connection)
CONFIG_BT_NIMBLE_MAX_CONNECTIONS=1

# Power management: enable light sleep
CONFIG_PM_ENABLE=y
CONFIG_PM_DFS_INIT_AUTO=y

# Watchdog
CONFIG_ESP_TASK_WDT_EN=y
CONFIG_ESP_TASK_WDT_TIMEOUT_S=10

# OTA: enable
CONFIG_BOOTLOADER_APP_ROLLBACK_ENABLE=y

# Log level: info for development, warn for production
CONFIG_LOG_DEFAULT_LEVEL_INFO=y

# --- PowerPuck-specific overrides ---

# Device name: "PowerPuck" instead of "PowerFinger Ring"
CONFIG_POWERFINGER_DEVICE_NAME="PowerPuck"

# Idle-to-sleep timeout: 60s (longer than ring's 45s to survive typing pauses)
CONFIG_POWERFINGER_SLEEP_TIMEOUT_MS=60000

# Sensor: PAW3204 optical (P0 prototype)
CONFIG_SENSOR_PAW3204=y

# Click: snap dome (whole-puck press-down)
CONFIG_CLICK_SNAP_DOME=y
```

## firmware/ring/sdkconfig.defaults
```kconfig
# SPDX-License-Identifier: MIT
# PowerFinger Ring — Default Kconfig

# Target: ESP32-C3
CONFIG_IDF_TARGET="esp32c3"

# Flash: 4MB
CONFIG_ESPTOOLPY_FLASHSIZE_4MB=y

# Partition table: custom (OTA A/B + NVS)
CONFIG_PARTITION_TABLE_CUSTOM=y
CONFIG_PARTITION_TABLE_CUSTOM_FILENAME="partitions.csv"

# Bluetooth: NimBLE only (no classic BT on C3)
CONFIG_BT_ENABLED=y
CONFIG_BT_NIMBLE_ENABLED=y
CONFIG_BT_NIMBLE_ROLE_PERIPHERAL=y
CONFIG_BT_NIMBLE_ROLE_CENTRAL=n
CONFIG_BT_NIMBLE_ROLE_OBSERVER=n
CONFIG_BT_NIMBLE_ROLE_BROADCASTER=y

# NimBLE: enable bonding, security manager
CONFIG_BT_NIMBLE_SM_LEGACY=y
CONFIG_BT_NIMBLE_SM_SC=y

# NimBLE: max connections (ring is peripheral, 1 connection)
CONFIG_BT_NIMBLE_MAX_CONNECTIONS=1

# Power management: enable light sleep
CONFIG_PM_ENABLE=y
CONFIG_PM_DFS_INIT_AUTO=y

# Watchdog
CONFIG_ESP_TASK_WDT_EN=y
CONFIG_ESP_TASK_WDT_TIMEOUT_S=10

# OTA: enable
CONFIG_BOOTLOADER_APP_ROLLBACK_ENABLE=y

# Log level: info for development, warn for production
CONFIG_LOG_DEFAULT_LEVEL_INFO=y
```
